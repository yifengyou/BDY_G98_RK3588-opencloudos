## drivers/crypto/sedriver/Kconfig
```kconfig
#
# se chip configuration
#
config SW_SE_CHIP
	tristate "se chip driver"
	depends on LOONGARCH
	help
		If unsure, say N.
```

## drivers/net/ethernet/dapustor/Kconfig
```kconfig
# SPDX-License-Identifier: GPL-2.0-only
#
# Dapustor network device configuration
#

config NET_VENDOR_DAPUSTOR
	bool "Dapustor devices"
	default y
	help
	  If you have a network (Ethernet) card from Dapustor(R), say Y.

	  Note that the answer to this question doesn't directly affect the
	  kernel: saying N will just cause the configurator to skip all
	  the questions about Dapustor(R) cards. If you say Y, you will
	  be asked for your specific card in the following questions.

if NET_VENDOR_DAPUSTOR

config DN200
	tristate "Dapustor(R) DN200 PCI Express adapters support"
	depends on PCI
	select MII
	help
	  This driver supports Dapustor(R) DN200 PCI Express family of
	  adapters.

	  To compile this driver as a module, choose M here. The module
	  will be called dn200.

endif #NET_VENDOR_DAPUSTOR
```

## drivers/net/ethernet/dinghai/Kconfig
```kconfig
config NET_VENDOR_DINGHAI
    tristate "Dinghai Devices"
    depends on (X86 || ARM64)
    default y
    help
      If you have a Ethernet DINGHAI device belonging to this
	  class, say y.

if NET_VENDOR_DINGHAI

config DINGHAI_DH_CMD
    tristate "Dinghai DH_CMD Support"
    depends on (X86 || ARM64)
    default m
    help
      Command interface for Dinghai devices.

config DINGHAI_EN_AUX
    tristate "Dinghai Auxiliary Support"
    depends on (X86 || ARM64)
    default y
    help
      Auxiliary functionality for Dinghai devices.

config DINGHAI_NP
    tristate "Dinghai NP Support"
    default m
    depends on DINGHAI_DH_CMD && (X86 || ARM64)
    help
      Network Processor (NP) support. Requires DINGHAI_DH_CMD.

config DINGHAI_PTP
    tristate "Dinghai PTP Support"
    depends on (X86 || ARM64)
    default m
    depends on DINGHAI_DH_CMD && PTP_1588_CLOCK && (X86 || ARM64)
    help
      Precision Time Protocol (PTP) support. Requires DINGHAI_DH_CMD and PTP_1588_CLOCK.

config DINGHAI_TSN
    bool "Dinghai Support TSN Macro"
    depends on (X86 || ARM64)
    default y
    help
      Enable TSN-related compile-time macros.

config DINGHAI_TSN_M
    tristate "Dinghai TSN Module Support"
    depends on (X86 || ARM64)
    default m
    help
      TSN runtime module support.

config ZXDH_SF
    tristate "Dinghai SF Support"
    depends on (X86 || ARM64)
    default y
    help
      Sub-Function (SF) support.

config ZXDH_MSGQ
    tristate "Dinghai MSGQ Support"
    depends on (X86 || ARM64)
    default m
    help
      Message queue support.

config DINGHAI_SEC
    tristate "Dinghai SEC Support"
    depends on (X86 || ARM64)
    default n
    help
      Security (SEC) module support.

config DINGHAI_AUXILIARY
    tristate "Dinghai AUXILIARY Support"
    depends on (X86 || ARM64)
    default m
    help
      Enable Dinghai AUXILIARY module Support

# Main PF driver
config DINGHAI_PF
    tristate "Dinghai PF Support"
    default m
    depends on DINGHAI_DH_CMD
    depends on DINGHAI_AUXILIARY
    depends on DINGHAI_NP
    depends on DINGHAI_PTP
    depends on DINGHAI_TSN_M
    depends on (X86 || ARM64)
    help
      Primary Function (PF) driver for Dinghai devices.
      This driver requires CMD, Auxiliary, NP, PTP, and TSN modules.
      Note: PTP also requires PTP_1588_CLOCK to be enabled.

endif # NET_VENDOR_DINGHAI
```

## drivers/net/ethernet/tcnic/Kconfig
```kconfig
config THIRDPARTY_TCNIC_NET
	tristate "Tencent CNIC network driver"
	default n
	depends on PCI
	select NET_FAILOVER
	help
	  This is the virtual network driver for Tencent CNIC network card.  Say Y or M.
```

## drivers/net/ethernet/yusur/Kconfig
```kconfig
# SPDX-License-Identifier: GPL-2.0
#
# Yusur driver configuration
#

config NET_VENDOR_YUSUR
	bool "Yusur devices"
	default y
	help
	  Yusur ethernet adapters menu.
	  Say Y here to show Yusur ethernet driver options.
	  Say N will hide all Yusur ethernet driver options.

if NET_VENDOR_YUSUR

source "drivers/net/ethernet/yusur/yk3/Kconfig"

endif # NET_VENDOR_YUSUR
```

## drivers/net/ethernet/yusur/yk3/Kconfig
```kconfig
# SPDX-License-Identifier: GPL-2.0
#
# Yusur driver configuration
#

config YK3
	tristate "Yusur YK3 Ethernet support"
	depends on PCI_MSI && (X86 || ARM64)
	help
	  This driver supports Yusur YK3 Ethernet adapters.

	  To compile this driver as a module, choose M here.
	  The module will be called yk3.
```

## drivers/pnp/pnpacpi/Kconfig
```kconfig
# SPDX-License-Identifier: GPL-2.0-only
#
# Plug and Play ACPI configuration
#
config PNPACPI
	bool
	default (PNP && ACPI) if !KATA_SUPPORT
	default 0 if KATA_SUPPORT
```

## drivers/thirdparty/Kconfig
```kconfig
# SPDX-License-Identifier: GPL-2.0
menu "Thirdparty Drivers"

config THIRDPARTY_BNXT
	bool
	default y

config THIRDPARTY_I40E
	bool
	default y

config THIRDPARTY_ICE
	bool
	default y

config THIRDPARTY_IAVF
	bool
	default y

endmenu
```

## kernel/tkernel/Kconfig
```kconfig
# SPDX-License-Identifier: GPL-2.0-only
#
# TKernel configuration
#
menuconfig TKERNEL
	bool "Tencent Kernel Features"
	default y

if TKERNEL

config TKERNEL_NONPRIV_NETBIND
	bool "Allow non-privileged user to bind specific low ports"
	default n
	help
	  When enabled, the administrator can allow unprivileged processes
	  to bind to specific low-numbered ports (< 1024) via the
	  /proc/tkernel/nonpriv_netbind interface.  This avoids the need
	  to grant CAP_NET_BIND_SERVICE for a single-port use case.

config TKERNEL_TTOOLS
	tristate "Tencent Kernel TTools"
	default n
	help
	  Provides ptrace-based process protection.  A process can mark
	  itself as ptrace-protected via prctl(), preventing other
	  processes from attaching with PTRACE_ATTACH.  Useful for
	  security-sensitive daemons that must not be traced.

config TKERNEL_NETATOP
	tristate 'Netatop support'
	default n
	depends on NETFILTER
	help
		Netatop module from TKernel

config TKERNEL_SHIELD_MOUNTS
	bool 'Shield mount'
	default n
	help
	  Allows the administrator to mark specific mount points as
	  shielded, preventing unprivileged users from accessing or
	  listing them.  Configured through a proc interface.  This
	  is useful in multi-tenant environments where certain mounts
	  (e.g. security agent filesystems) should be invisible to
	  container workloads.

config TKERNEL_SECURITY_MONITOR
	bool "security monitor"
	default y
	help
		Allow user to add security monitor

config TKERNEL_AEGIS_MODULE
	tristate "ONION aegis module"
	default n
	help
		ONION aegis module

config TKERNEL_IRQ_LATENCY
	tristate "irq latency debug"
	depends on STACKTRACE
	default m
	help
	  This option adds support for irq latency debug.

config TKERNEL_KILL_HOOK
	bool "kill hook"
	default n
	help
	  This option enables the kill hook interface to support
	  kill interception.

config TKERNEL_KILL_BLOCK
	tristate "block kill signal"
	default m
	depends on CGROUPS
	select GLOB
	select TKERNEL_KILL_HOOK
	help
	  This option enables the kill block feature.
	  If the kill signal match the block rule, it will be blocked.
	  This feature is useful to some k8s user who don't allow k8s
	  kill user process.

config TKERNEL_KILL_PROTECT
	tristate "Protect some processes from being killed"
	default m
	select TKERNEL_KILL_HOOK
	help
	  This option enables the kill protect feature.
	  If the kill signal match the protect rule, it will be ignored.
	  This feature is useful to some user who don't allow being killed
	  by SIGKILL and SIGTERM.

endif
```

## security/biba/Kconfig
```kconfig
#
config SECURITY_BIBA
	bool "BIBA Support"
	select SECURITY
	select SECURITY_NETWORK
	default y
	help
	  This selects BIBA.

config SECURITY_BIBA_STATUS
	bool "BIBA Runtime Status"
	depends on SECURITY_BIBA
	default y
	help
	  This selects BIBA runtime status.

config SECURITY_BIBA_AUDIT
	bool "BIBA Audit Support"
	depends on SECURITY_BIBA && AUDIT
	default y
	help
	  This selects BIBA audit.

config SECURITY_BIBA_PARSER_DEBUG
	bool "BIBA Parser Debug Support"
	depends on SECURITY_BIBA
	default n
	help
	  This selects BIBA Parser Debug.
```

## security/shellguard/Kconfig
```kconfig
# SPDX-License-Identifier: GPL-2.0-only
config SHELL_GUARD
	bool "Shell Guard Security Module"
	depends on SECURITY && X86
	default y
	help
	  This selects Shell Guard.
```
