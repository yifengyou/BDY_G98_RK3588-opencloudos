## drivers/iommu/hisilicon/Kconfig
```kconfig
# SPDX-License-Identifier: GPL-2.0+
#
# Hisilicon UMMU support
#

source "drivers/iommu/hisilicon/ummu-core/Kconfig"

config UB_UMMU_BASE
	bool "Hisilicon UB MMU Support Builtin"
	depends on ARM64
	default n
	help
	  Support for implementations of the hisilicon UMMU architecture.
	  As the kernel provides the basic functionality for using UMMU features.
	  Say Y here if your Soc includes an UMMU device implementing
	  the Hisilicon UMMU architecture.

config UB_UMMU
	tristate "Hisilicon UB MMU Support"
	depends on ARM64 && ARCH_HISI
	depends on UB_UBUS && UB_UBFI && UB_UBRT_PLAT_DEV
	default n
	select IOMMU_API
	select IOMMU_IO_PGTABLE_LPAE
	select GENERIC_MSI_IRQ
	select IOMMUFD_DRIVER if IOMMUFD
	select UMMU_CORE
	select UB_UMMU_BASE
	help
	  Support for implementations of the hisilicon UMMU architecture.
	  UMMU provides address translation for device access to the
	  local host.
	  Say Y here if your Soc includes an UMMU device implementing
	  the Hisilicon UMMU architecture.
```

## drivers/iommu/hisilicon/ubmem-mmu/Kconfig
```kconfig
# SPDX-License-Identifier: GPL-2.0+

menuconfig UB_UBMEM_VMMU
	default n
	tristate "ubmem_vmmu driver"
	depends on UB_UMMU_CORE && UB_UMMU
	help
	   This option enables support for UBMEM_VMMU drivers. The
	   UBMEM_VMMU driver provides VMU device registration,
	   initialization, address mapping, and un-mapping inside
	   a VM.
```

## drivers/iommu/hisilicon/ummu-core/Kconfig
```kconfig
# SPDX-License-Identifier: GPL-2.0+

config UB_UMMU_CORE
	bool "UMMU Framework Builtin API"
	default n
	depends on UB_UBUS
	help
	  Enable the UMMU framework and configure this config, as the kernel
	  provides the basic functionality for using UB features. This config
	  is built-in by default if you are using UB features.
	  Say 'Y' here if you are using UB.

if UB_UMMU_CORE
config UB_UMMU_CORE_DRIVER
	tristate "UMMU Framework Modular API"
	default n
	help
	  The configuration is flexible and depends on how the ummu driver
	  intends to utilize this feature. This configuration option
	  encompasses various features that the driver may use.
	  If the driver wishes to employ the UB feature, this
	  configuration must be enabled.
	  Select 'M' to build these features as a loadable kernel module.

config UB_UMMU_SVA_SEPARATED_PAGES
	bool "Support for UMMU SVA to establish separated page tables"
	default n
	help
	  the hardware does not support IOPF capability, using SVA
	  ared page tables can lead to page faults due to periodic
	  mory tasks. By separating the process page table from the
	  MMU page table, the goal of SVA programming is achieved.
	  using SVA in this scenario say 'Y' here.
endif
```

## drivers/ub/sentry/Kconfig
```kconfig
# SPDX-License-Identifier: GPL-2.0-only

config UB_SENTRY
    tristate "sentry message report"
    depends on UB && ACPI_POWER_NOTIFIER_CHAIN
    default m
    help
      Listens to kernel event(eg. oom) and send sentry msg to userspace
      Provides device for userspace to read kernel message and reply ack
      Provides kernel api to send message to userspace and wait for result
```

## drivers/ub/ubdevshm/Kconfig
```kconfig
# SPDX-License-Identifier: GPL-2.0+
menuconfig UB_UBDEVSHM
	default n
	tristate "ubdevshm driver"
	help
	   This option enables support for ubdevshm drivers. ubdev_shm serves
	   as a basic mechanism, providing the ability for different memory providers
	   to register and access or deregister and exit, managing shared memory
	   contexts, and providing shared memory information for memory users.
```
